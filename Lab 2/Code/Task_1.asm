;>>>>>>>>>>>>>>>>>>>>>>>>>>>>>>>>>>>>>>>>>>>>>>>>>>>>>>>>>>>
; 1DT301, Computer Technology I
; Date: 2021-10-12
; Author:
;	Philomina Ejegi Ede
;	Melat Haile
;
; Lab number: 2
; Title: Task 1
;
; Hardware: STK600, CPU ATmega2560
;
; Function: A program that switches between a Ring counter and a Johnson counter. You should not 
;			use interrupts in this assignment. The push button must be checked frequently, so there is no 
;			delay between the button is pressed and the change between Ring/Johnson. Use SW0 (PA0) for 
;			the button. Each time you press the button, the program should change counter.
;
; Input ports: PORTD is used to check if we pressed the switch 0.
;
; Output ports: PORTB is used to turn on/off the LEDs.
;
; Subroutines: If applicable.
; Included files: m2560def.inc
;
; Other information:
;
; Changes in program: (Description and date)
;<<<<<<<<<<<<<<<<<<<<<<<<<<<<<<<<<<<<<<<<<<<<<<<<<<<<<<<<<<<

.include "m2560def.inc"

; Initialize SP, Stack Pointer
ldi r21, HIGH(RAMEND) ; R20 = high part of RAMEND address
out SPH,R21 ; SPH = high part of RAMEND address
ldi R21, low(RAMEND) ; R20 = low part of RAMEND address
out SPL,R21 ; SPL = low part of RAMEND address

; Initialize
ldi r16, 0xFF 
out DDRB, r16 

ldi r17, 0x00
out DDRD, r17 

ldi r16, 0xFF
out PORTB,r16 

ldi r20, 0b11111110 
ldi r19, 0b10111111 
ldi r22,0x00

loop:
	in r18, PIND 
	cp r20,r18 
	breq ring_counter 
	brne johnson_counter 

;LED -> 0 == on and 1 == off
ring_counter:
	ldi r18, 0b11111110
	call ring_loop

ring_loop:
	out PORTB, r18 
	call Delay					
	com r18						
	LSL r18						
	;So here we would get for the first r18 : 0000 0010
	com r18						

	;Check if everything is off if true then go to ring counter to make infinite loop
	ldi r24,0xFF	
	cp r24, r18					
	breq ring_counter		

;We check if we pressed SW0, if yes we go to Johnson_counter
	in r19, PIND
	cp r20,r19
	breq johnson_counter

	rjmp ring_loop				


rjmp loop						

johnson_counter :
	ldi r19, 0b11111110			
	ldi r22, 0x00

johnson_loop:
	out PORTB, r19				
	LSL r19						
	; r19 = 1111 1100
	call Delay
	cp r19, r22					
	breq johnson				

;Check if PIND SW0 has been pressed if yes then it goes to ring counter
	in r18, PIND
	cp r20,r18
	breq ring_counter

	rjmp johnson_loop

rjmp loop 

; Reverse
johnson :
	out PORTB, r22				
	ldi r22, 0b11111111			
	call Delay
	ldi r19,0b10000000			

	more_john :
		out PORTB, r19			
		ASR r19					
		
		call Delay
		cp r19, r22				
		breq johnson_counter	

;Check if PIND SW0 has been pressed if yes then it goes to ring counter
		in r18, PIND
		cp r20,r18
		breq ring_counter

	rjmp more_john



Delay :
; Generated by delay loop calculator
; at http://www.bretmulvey.com/avrdelay.html

	ldi  r21, 5
    ldi  r23, 20
    ldi  r24, 175
L1: dec  r24
    brne L1
    dec  r23
    brne L1
    dec  r21
    brne L1
	ret
