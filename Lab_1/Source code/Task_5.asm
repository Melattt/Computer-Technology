;>>>>>>>>>>>>>>>>>>>>>>>>>>>>>>>>>>>>>>>>>>>>>>>>>>>>>>>>>>>
; 1DT301, Computer Technology I
; Date: 2021-09-28
; Author:
; Philomina Ejegi Ede
; Melat Haile
;
; Lab number: 1
; Title: Task 5
; Subroutine call.
; Hardware: STK600, CPU ATmega2560
;
; Function: Create a program that creates a Ring Counter with a delay
; of 0.5 seconds.
;
; Output ports: The portB is used as an output port
;
; Subroutines: Timer
;<<<<<<<<<<<<<<<<<<<<<<<<<<<<<<<<<<<<<<<<<<<<<<<<<<<<<<<<<<<
.include "m2560def.inc"
main:
	; Initialize SP, Stack Pointer
	ldi r20, HIGH(RAMEND)	; R20 = high part of RAMEND address
	out SPH,R20             ; SPH = high part of RAMEND address
	ldi R20, low(RAMEND)    ; R20 = low part of RAMEND address
	out SPL,R20             ; SPL = low part of RAMEND address
	ldi r20, 0xFF
	out DDRB, r20
	cbr r20, 1				
	out PORTB, r20
	call timer
lightloop:
	LSL r20				;Logical shift to the left
	brcs setbit			;Branch if carry set
lightloopcount:
	out PORTB, r20
	call timer
	rjmp lightloop
setbit:
	SBR r20, 1			;Set bit register
	clc					;Clear carry flag
	rjmp lightloopcount
timer:
; Generated by delay loop calculator at http://www.bretmulvey.com/avrdelay.html
	ldi  r17, 5
    ldi  r18, 20
    ldi  r19, 175
L1: dec  r19
    brne L1
    dec  r18
    brne L1
    dec  r17
    brne L1
	ret





